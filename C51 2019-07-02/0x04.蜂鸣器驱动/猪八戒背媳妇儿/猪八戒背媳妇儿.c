#include <reg52.h> 
#define uchar unsigned char 
#define uint unsigned int 
sbit fm=P1^5;// 蜂鸣器控制端口
uchar timeh,timel;// 用于存放定时器的高 8 位和低 8 位
uchar code zbjbxf[]={//定义猪八戒背媳妇的简谱数组
	0x64,0xA3,0xC1,0xA2,0x62,0x84,0x61,0x81,0x61,0xA4,
	0xA1, 0x91,0xA1,0x81,0x64,0xA3,0xC1,0xD2,0xD2,0xD2,
	0xA2,0xC4, 0xA1,0xC1,0xA1,0xC1,0xD2,0xD2,0xD2,0xA2,0xC4,0xC2,0x62, 
	0xC2,0x62,0xA2,0xA2,0x84,0x94,0x94,0x92,0x81,0x91, 
	0xA2,0xC2,0xD4,0xE4,0xA4,0xE4,0xA2,0xE2,0xA2,0xE2,0xA2, 
	0xA2,0x84,0x94,0x94,0x92,0x81,0x91,0xA2,0xC2,0xD8}; 
	// 适合 12M 的晶振定时器初值表，高低 8 位分开
	uchar code chuzhi[]={ 
		0xff,0xff,//占位0xFC,0x8E,//中央 C调 1-7 
		0xFC,0xED, 
		0xFD,0x43, 
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		0xFF,0x16//-西安科技大学 - 
	}; 
	void timer0() interrupt 1 // 定时器 0 中断服务程序
	{ 
		TH0=timeh; // 将 timeh 赋给计时器的高 8 位
		TL0=timel; // 将 timel 赋给计时器的低 8 位
		fm=~fm; // 定时器每次到时将蜂鸣器反相
	} 
	void delay(uint z) //延时 165MS,即十六分音符
	{ uint y; 
	for(z;z>0;z--) 
		for(y=19000;y>0;y--);//大致时间
	} 
	void delay1(uint z) // 延时 1MS 
	{ uint y; 
	for(z;z>0;z--) 
		for(y=112;y>0;y--);//大致时间
	} 
	void main() 
	{ 
		uint temp; // 存放简谱数组中的每一个音符的临时变量
		uchar i=0; 
		uchar jp; //jp 用于取出 temp 中的高 8 位和低 8 位
		TMOD=0x01;//设置定时器 T0工作于方式 1 
		IE=0x82; // 允许 T0中断
		while(1) 
		{ 
			temp=zbjbxf[i]; 
			if(temp==0xff) 
				break; 
			jp=temp/16; // 取数的高 4 位，音频数值-西安科技大学 - 
			if(jp!=0) 
			{ 
				timeh=chuzhi[jp*2];// 构造定时器初值高 8 位
				timel=chuzhi[jp*2+1]; // 构造定时器初值低 8 位
				TR0=1; // 开定时器
			} 
			else 
			{ 
				TR0=0; // 关定时器
				fm=1; // 关蜂鸣器
			} 
			delay(temp%16); //取数的低 4 位,节拍（音符总时延）
			TR0=0; // 唱完一个音停 5MS 
			fm=1; 
			delay1(5); //TR0=1; 
			i++; 
		} 
		TR0=0; //关定时器
		fm=1; //关蜂鸣器
	}  