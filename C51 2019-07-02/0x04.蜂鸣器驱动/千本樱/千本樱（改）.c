/************************************************************************  
[文件名]  C51音乐程序 
[功能]    通过单片机演奏音乐  

/**********************************************************************/   
#include <REG52.H>    
#include <INTRINS.H>    
#include "reg52.h"	
typedef unsigned int u16;	  //对数据类型进行声明定义
typedef unsigned char u8;

sbit k1=P3^1;	 //定义P31口是k1



sbit Beep =  P1^5; 

unsigned char n=0;      
unsigned char code music_tab[] ={ 0xff,  


	0x1c,0x10,0x1c,0x20,0x20,0x10,
	0x1c,0x10,0x1c,0x20,0x20,0x10,
	0x1c,0x10,0x1c,0x20,0x20,0x10,
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	0xff,0xff,0xff,0xff ,


	0x00 
};   


unsigned char code music_tab1 [] = { 0xff,    0x18,0x08,0x15,0x10,0x13,0x10,
	0x1c,0x08,0x20,0x08,0x1c,0x08,0x20,0x08,
	0x15,0x10,0x13,0x10,
	0x1c,0x08,0x20,0x08,0x1c,0x08,0x20,0x08,
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	0x1c,0x20,0x1c,0x10,0x20,0x10,0x1c,0x40,


	0x00}		   ;





unsigned char code  music_tab2 [] ={  	0x1c,0x20,0x1c,0x18,0x20,0x08,
	0x1c,0x10,0x18,0x10,0x15,0x10,0x13,0x10,
	0x1c,0x20,0x1c,0x18,0x20,0x08,
	0x1c,0x10,0x20,0x10,0x26,0x10,0x20,0x10	 ,
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	0x1c,0x10,0x1c,0x20,0x1c,0x10,0x18,0x20,0x15,0x20,0x19,0x60,


	0x00
};


unsigned char code   music_tab3[] ={ 	   0x1c,0x10,0x18,0x10,0x15,0x10,0x15,0x20,0x13,0x10,0x13,0x30,0x13,0x10,
	0x10,0x10,
	0x0e,0x10,0x15,0x10,0x18,0x10,0x13,0x20,
	0x1c,0x10,0x18,0x10,0x15,0x10,0x15,0x20,0x13,0x10,0x13,0x30,
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	0x15,0x10,0x18,0x10,0x12,0x10,0x10,0x10,0x0e,0x80,    

	0x00 
}		;







void int0()  interrupt 1      
{  TH0=0xd8;   
TL0=0xef;   
n--;   
}   

void delay (unsigned char m)      
{   
	unsigned i=3*m;   
	while(--i);   
}   

void delayms(unsigned char a)  
{   
	while(--a);               
}   														 
















void main()   
{
	unsigned char p,m;    
	unsigned char i=0;   
	TMOD&=0x0f;   
	TMOD|=0x01;   
	TH0=0xd8;TL0=0xef;   
	IE=0x82;
	while(1)
	{	
		if(k1==0)		  //检测按键K1是否按下
		{	
			delay(1000);   //消除抖动 一般大约10ms
			if(k1==0)	 //再次判断按键是否按下
			{
				goto play;	  //led状态取反
			}
			while(!k1);	 //检测按键是否松开
		}		
	}   
play:   
while(1)   
{


a: p=music_tab[i];   
	if(p==0x00)       { i=0, delayms(1000); goto b;}     
	else if(p==0xff)  { i=i+1;delayms(100),TR0=0; goto a;}      
	else         {m=music_tab[i++], n=music_tab[i++];}      
	TR0=1;                                                 
	while(n!=0) Beep=~Beep,delay(m);                           
	TR0=0; 
	goto a   ;
b: p=music_tab1[i];   
	if(p==0x00)       { i=0, delayms(1000); goto c;}     
	else if(p==0xff)  { i=i+1;delayms(10),TR0=0; goto b;}      
	else         {m=music_tab1[i++], n=music_tab1[i++];}      
	TR0=1;                                                 
	while(n!=0) Beep=~Beep,delay(m);                           
	TR0=0;   
	goto b ;
c: p=music_tab2[i];   
	if(p==0x00)       { i=0, delayms(1000); goto d;}     
	else if(p==0xff)  { i=i+1;delayms(100),TR0=0; goto c;}      
	else         {m=music_tab2[i++], n=music_tab2[i++];}      
	TR0=1;                                                 
	while(n!=0) Beep=~Beep,delay(m);                           
	TR0=0;   
	goto c;
d: p=music_tab3[i];   
	if(p==0x00)       { i=0, delayms(1000); goto stop;}     
	else if(p==0xff)  { i=i+1;delayms(100),TR0=0; goto d;}      
	else         {m=music_tab3[i++], n=music_tab3[i++];}      
	TR0=1;                                                 
	while(n!=0) Beep=~Beep,delay(m);                           
	TR0=0;     
	goto d;                               
}  
stop :
while(1)
{}
}