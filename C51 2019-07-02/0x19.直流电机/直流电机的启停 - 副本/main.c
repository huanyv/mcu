/**************************************************************************************
*		              直流电机实验												  *
实现现象：下载程序后，按照光盘内操作视频接线，直流电机旋转大约5S，然后停止
注意事项：无																				  
***************************************************************************************/

#include "reg52.h"			 //此文件中定义了单片机的一些特殊功能寄存器
#include<intrins.h>		//因为要用到左右移函数，所以加入这个头文件

typedef unsigned int u16;	  //对数据类型进行声明定义
typedef unsigned char u8;

sbit moto=P1^0;

sbit k1=P3^1;
sbit k2=P3^0;
sbit k3=P3^2;	  	 

/*******************************************************************************
* 函 数 名         : delay
* 函数功能		   : 延时函数，i=1时，大约延时10us
*******************************************************************************/
void delay(u16 i)
{
	while(i--);	
}

void stop()
{
	EA=1;ET0=1;IT0=1;
}

void main()
{	
//	u8 i;
	stop();
	moto=0;			//关闭电机
	while(1)
	{	
						
	}
}

void stop0() interrupt 0
{
	delay(2000);
	if(k3==0)
	{
		moto=~moto;
	}
}
